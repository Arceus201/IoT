//Template ID Blynk 

#define BLYNK_TEMPLATE_ID "TMPLZX_Ozrjl"
#define BLYNK_DEVICE_NAME "TieuLuanIoT"
#define BLYNK_AUTH_TOKEN "EqFvRPo4TG2uq6Ql4ywXc5aKu1P4cDMy"

// Các thư viện wifi, blynk,dht
#define BLYNK_PRINT Serial
#include <WiFi.h>
#include <BlynkSimpleEsp32.h>
//Thư viện này cho phép bạn gửi và nhận tín hiệu hồng ngoại 
//trên ESP8266 hoặc ESP32
#include <IRremoteESP8266.h>
#include <IRsend.h>
#include <DHT.h>
// cac biến liên quan đến chân gpio, switch
int pinValue = 0;// tùy chỉnh
int pinValue1 = 0;// điều hòa
int pinValue2 = 0;// máy tạo ẩm
int pinValue3;// slider điều chỉnh nhiệt độ điều hòa
char auth[] = BLYNK_AUTH_TOKEN;

char ssid[] = "MI 8 SE";  // name wifi
char pass[] = "04062001";  // pass word wifi

BlynkTimer timer;

#define DHTPIN 4 //Connect to DHT22
//#define HumiPin 22 // connect to máy tạo ẩm 
const uint16_t kIrLed = 26;// connect IR phát tín hiệu hồng ngoại
#define DHTTYPE DHT22

IRsend irsend(kIrLed);
DHT dht(DHTPIN, DHTTYPE);

bool Button_on;// kiểm tra điều hòa bật tắt
// biến đánh dấu để  bật tắt điều hòa 1 lần khi nhiệt độ thay đổi
// nếu không có biến đánh dấu này, điều hòa sẽ bị bật tắt ko kiểm soát
bool ok1;
bool ok2;
int td1;
int td2;




// void td_may_tao_am(float h){
//   // tự động bật máy tạo ẩm nếu độ ẩm dưới 40%
//   if(h<40){
//    Blynk.virtualWrite(V4, 1);              
//     digitalWrite(HumiPin, HIGH);
//   }
//   else{// tự động tắt máy tạo ẩm nếu độ ẩm >40%
//    Blynk.virtualWrite(V4, 0);              
//     digitalWrite(HumiPin, LOW);
//   }
// }

// //che de dieu khien
// void bat_may_tao_am(int pinValue2){
//   if(pinValue2 == 1  ){
//    Blynk.virtualWrite(V4, 1);              
//     digitalWrite(HumiPin, HIGH);
//   }
//   else{
//    Blynk.virtualWrite(V4, 0);              
//     digitalWrite(HumiPin, LOW);
//   }
// }

	// hàm setuo
void setup(){   

  Serial.begin(115200);// đọc Serial monitor ở tốc độ 115200
  pinMode(DHTPIN, INPUT);
  //set PinMode cho các đầu ra
   //pinMode(HumiPin, OUTPUT);
  //// Đặt các đầu ra ở chế độ LOW - OFF
  //digitalWrite(HumiPin, LOW);
  // Kết nối tới Blynk

  td1=0;
  td2=0;
  Blynk.begin(auth, ssid, pass);
  dht.begin();
  irsend.begin();
  

  }

//ktra bật tắt tuy chinh
BLYNK_WRITE(V2){
  pinValue = param.asInt();
}

// kiểm tra bật tắt Air
BLYNK_WRITE(V3){
  pinValue2 = param.asInt();
  if(pinValue2 == 1){
      Button_on = true;
      ok1 = true;
    }
    else{
      Button_on = false;
      ok2=true;
    }
}
BLYNK_WRITE(V5){ // lấy giá trị nhiệt độ điều hòa
   pinValue3 = param.asInt();
}
//ktra  bật tắt máy tạo ẩm
// BLYNK_WRITE(V4){
//   pinValue2 = param.asInt();
// }

// điều khiển bật tắt điều hòa
void controlAir(uint16_t rawData[211],uint16_t rawData_Off[211],uint8_t state_on[13],uint8_t state_off[13]){
  if(Button_on== true && ok1 == true){
      irsend.sendRaw(rawData, 211, 38);
      delay(1000);
      irsend.sendElectraAC(state_on,13,2);
      ok1=false;
    }
    if(Button_on == false && ok2 == true){
      irsend.sendRaw(rawData_Off, 211, 38);
      delay(1000);
      irsend.sendElectraAC(state_off,13,2);
      ok2 = false;
    }
}

// Các mã IR điều khiển bật tắt điều hòa tương ứng 
// với các nhiệt độ từ 25-28
// thu được sau khi thực hiện thu tín hiệu hồng ngoại
//ở phần trước
void xulyAir(){
  {
    Serial.print(pinValue3);
    if(pinValue3==25){
      uint16_t rawData[211]  = {8966, 4562,  500, 1752,  500, 1752,  496, 638,  474, 614,  526, 584,  498,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 1730,  500};  // UNKNOWN F9924DF2

      uint16_t rawData_Off[211] = {8970, 4538,  522, 1752,  502, 1750,  500, 614,  498, 612,  500, 610,  526,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 614,  498};  // UNKNOWN 2F6C1E4D

    //controlAir(rawData,rawData_Off);
  }

  else if(pinValue3==26){
      uint16_t rawData[211] = {9028, 4504,  558, 1694,  558, 1692,  560, 552,  556, 554,  556, 554,  560,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 1730,  522};  // ELECTRA_AC
       uint8_t state_on[13] = {0xC3, 0x97, 0xE0, 0x00, 0x20, 0x00, 0x20, 0x00, 0x00, 0x20, 0x00, 0x05, 0x9F};

      uint16_t rawData_Off[211] = {9028, 4504,  532, 1718,  560, 1692,  532, 580,  560, 550,  534, 580,  556,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 590,  522};  // ELECTRA_AC
       uint8_t state_off[13] = {0xC3, 0x97, 0xE0, 0x00, 0x20, 0x00, 0x20, 0x00, 0x00, 0x00, 0x00, 0x05, 0x7F};

      controlAir(rawData,rawData_Off,state_on,state_off);
  }
  else if(pinValue3==27){
      uint16_t rawData[211] = {9030, 4500,  560, 1692,  558, 1694,  558, 554,  556, 556,  556, 554,  558,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 1806,  446};  // UNKNOWN 3E5B0D5A

      uint16_t rawData_Off[211] = {9024, 4506,  556, 1700,  550, 1698,  554, 556,  556, 556,  530, 580,  556,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 1728,  522};  // ELECTRA_AC

    //controlAir(rawData,rawData_Off);
  }
  else if(pinValue3==28){
      uint16_t rawData[211] = {9018, 4534,  528, 1724,  504, 1748,  500, 612,  502, 608,  500, 610,  502,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 1756,  496};  // UNKNOWN 5A708B48

      uint16_t rawData_Off[211] = {8996, 4556,  506, 1726,  524, 1726,  550, 584,  504, 588,  548, 584,  530,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 1730,  520};  // ELECTRA_AC

      //controlAir(rawData,rawData_Off);
  }
  
  }
}

// đọc dữ liệu từ cảm biển nhiệt độ độ ẩm DHT22
// hiển thị thông số lên blynk và serial monitor
//xử lý bật tắt các thiết bị đầu ra ở các chế độ điều khiển và tùy chỉnh
void sendSensor()
{
  float h = dht.readHumidity();// đọc giá trị độ ẩm từ cảm biến
  float t = dht.readTemperature(); // đọc giá trị nhiệt độ từ cảm biến
  //ktra xem co nhan nhiet do or đo am khong
  if (isnan(h) || isnan(t)) {
    Serial.println("Failed to read from DHT sensor!");
    return;
  }


  // Ghi kết quả Nhiệt độ, Độ ẩm lên 2 biến V0,V1 lên Blynk
    Blynk.virtualWrite(V0, t);
    Blynk.virtualWrite(V1, h);
    
    // Ghi kết quả Nhiệt độ, Độ ẩm lên 2 biến V0,V1 lên Serial monitor
    Serial.print("Temperature : ");
    Serial.print(t);
    Serial.print("    Humidity : ");
    Serial.println(h);
     
    // che độ điều khiển

    if(pinValue == 0){    
        xulyAir();
        td2=0;
        td1=0;
      //  bat_may_tao_am(pinValue2);        
    }
    // chế độ tự động
    else{   
        if((t<25 || t>28) &&(td1==0) ){
          Blynk.virtualWrite(V3, 1);  
          Button_on= true;
          ok1 = true;
           xulyAir();
          ok1=false;
          td1=1;
          td2=0;
        }
         else if((t>=25 && t<=28) && td2==0){
          Blynk.virtualWrite(V3, 0);
          Button_on= false;
          ok2 = true;
           xulyAir();
          ok2=false;
          td2=1;
          td1=0;
        }
      // td_may_tao_am(h);

    }
}
void loop()
{
  Blynk.run();
  sendSensor();
  delay(1000);
 }


 